## cellular-monitor - Copy/boards/arm/nowi_cellular/Kconfig.board
```kconfig
# Copyright (c) 2024 Nordic Semiconductor ASA
# SPDX-License-Identifier: Apache-2.0

if SOC_NRF9160_SICA

config BOARD_NOWI_CELLULAR
	bool "NOWi Cellular"

config BOARD_NOWI_CELLULAR_NS
	bool "NOWi Cellular non-secure"

endif # SOC_NRF9160_SICA
```

## cellular-monitor - Copy/boards/arm/nowi_cellular/nowi_cellular_defconfig
```kconfig
# Copyright (c) 2024 Nordic Semiconductor ASA
# SPDX-License-Identifier: Apache-2.0

CONFIG_SOC_SERIES_NRF91X=y
CONFIG_SOC_NRF9160_SICA=y
CONFIG_BOARD_NOWI_CELLULAR=y

# Enable MPU
CONFIG_ARM_MPU=y

# Enable hardware stack protection
CONFIG_HW_STACK_PROTECTION=y

# Enable TrustZone-M
CONFIG_ARM_TRUSTZONE_M=y

# Enable GPIO
CONFIG_GPIO=y

# Enable Pincontrol
CONFIG_PINCTRL=y
```

## cellular-monitor - Copy/boards/arm/nowi_cellular_nrf9151/Kconfig.board
```kconfig
config BOARD_NOWI_CELLULAR_NRF9151
	bool "Custom Board auto generated by nRF Connect for VS Code"
	depends on SOC_SERIES_NRF91X
	select SOC_NRF9151_LACA

config BOARD_NOWI_CELLULAR_NRF9151_NS
	bool "NOWi Cellular nRF9151 Non-Secure"
	depends on SOC_SERIES_NRF91X
	select SOC_NRF9151_LACA
```

## cellular-monitor - Copy/boards/arm/nowi_cellular_nrf9151/Kconfig.defconfig
```kconfig
# NOWi Cellular nRF9151 board configuration

# Copyright (c) 2024 NOWi
# SPDX-License-Identifier: Apache-2.0

if BOARD_NOWI_CELLULAR_NRF9151

config BOARD
	default "nowi_cellular_nrf9151"

endif # BOARD_NOWI_CELLULAR_NRF9151
```

## cellular-monitor - Copy/boards/arm/nowi_cellular_nrf9151/Kconfig.nowi_cellular_nrf9151
```kconfig
# NOWi Cellular nRF9151 board configuration

# Copyright (c) 2024 NOWi
# SPDX-License-Identifier: Apache-2.0

config BOARD_NOWI_CELLULAR_NRF9151
	select SOC_NRF9151_LACA
```

## cellular-monitor - Copy/boards/arm/nowi_cellular_nrf9151/board.yml
```yaml
board:
  name: nowi_cellular_nrf9151
  full_name: NOWi Cellular nRF9151
  vendor: nowi
  socs:
  - name: nrf9151
    variants:
    - name: 'ns'
```

## cellular-monitor - Copy/boards/arm/nowi_cellular_nrf9151/nowi_cellular_nrf9151_nrf9151_ns_defconfig
```kconfig
# Copyright (c) 2024 NOWi
# SPDX-License-Identifier: Apache-2.0

# Enable MPU
CONFIG_ARM_MPU=y

# Enable hardware stack protection
CONFIG_HW_STACK_PROTECTION=y

# Enable TrustZone-M
CONFIG_ARM_TRUSTZONE_M=y

# Enable Non-Secure execution
CONFIG_TRUSTED_EXECUTION_NONSECURE=y

# Enable GPIO
CONFIG_GPIO=y

# Enable serial drivers
CONFIG_SERIAL=y

# Enable console
CONFIG_CONSOLE=y
CONFIG_UART_CONSOLE=y

# Enable pinctrl
CONFIG_PINCTRL=y
```

## cellular-monitor - Copy/boards/sadadasd/test-board/Kconfig.defconfig
```kconfig
if BOARD_TEST-BOARD_NRF9151 || BOARD_TEST-BOARD_NRF9151_NS

config BOARD_TEST-BOARD
	select USE_DT_CODE_PARTITION if BOARD_TEST-BOARD_NRF9151_NS

endif # BOARD_TEST-BOARD_NRF9151 || BOARD_TEST-BOARD_NRF9151_NS
```

## cellular-monitor - Copy/boards/sadadasd/test-board/board.yml
```yaml
board:
  name: test-board
  vendor: sadadasd
  socs:
  - name: nrf9151
    variants:
    - name: ns
```

## cellular-monitor - Copy/boards/simulated.conf
```kconfig
# THIS SHOULD NEVER HE USED IN PRODUCTION
CONFIG_SIMULATED_MAG=y
# CONFIG_TESTING_DISABLE_MODEM=y
```
